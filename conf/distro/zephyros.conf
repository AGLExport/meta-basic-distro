## conf/distro/zephyros.conf
```bitbake
require conf/distro/poky.conf

# AGL specific derivations
DISTRO = "zephyros"
DISTRO_NAME = "Automotive Grade Linux Instrument Cluster"

DISTRO_VERSION = "0.0.1"
DISTRO_CODENAME = "zephyros-dundell"

# Override these in poky based distros
DISTRO_FEATURES := "systemd largefile opengl wayland alsa"
DISTRO_FEATURES_BACKFILL_CONSIDERED = "sysvinit gobject-introspection-data"

# Mirrors is not set
#PREMIRRORS ??= "\
#               "
#MIRRORS =+ "\
#           "

# init to use
VIRTUAL-RUNTIME_init_manager = "systemd"
VIRTUAL-RUNTIME_initscripts = ""

# base utils
VIRTUAL-RUNTIME_base-utils-syslog = ""

# device manager to use
PREFERRED_PROVIDER_udev ?= "systemd"
PREFERRED_PROVIDER_udev-utils ?= "systemd"

# network manager to use
VIRTUAL-RUNTIME_net_manager = "systemd" 

# disable console tools
PREFERRED_PROVIDER_console-tools = ""

# Write software version to image
INTEGRATED_SOFTWARE_VERSION ??= "${DISTRO}-${DISTRO_VERSION}"

EXTRA_IMAGECMD:append_erofs = " -L ${INTEGRATED_SOFTWARE_VERSION} "
EXTRA_IMAGECMD:append_erofs-lz4 = " -L ${INTEGRATED_SOFTWARE_VERSION} "
EXTRA_IMAGECMD:append_erofs-lz4hc = " -L ${INTEGRATED_SOFTWARE_VERSION} "
EXTRA_IMAGECMD:append_ext4 = " -L ${INTEGRATED_SOFTWARE_VERSION} "
```

## conf/layer.conf
```bitbake
# We have a conf and classes directory, add to BBPATH
BBPATH =. "${LAYERDIR}:"

# We have recipes-* directories, add to BBFILES
BBFILES += "${LAYERDIR}/recipes-*/*/*.bb \
            ${LAYERDIR}/recipes-*/*/*.bbappend"

BBFILE_COLLECTIONS += "basic-distro"
BBFILE_PATTERN_basic-distro = "^${LAYERDIR}/"
BBFILE_PRIORITY_basic-distro = "80"
LAYERSERIES_COMPAT_basic-distro = "dunfell"
```
